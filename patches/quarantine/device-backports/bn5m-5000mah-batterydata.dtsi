/*
 * bn5m-5000mah-batterydata.dtsi — Corrected battery profile for
 * Redmi Note 12 4G (topaz/tapas) BN5M 5000mAh Li-Po cell.
 *
 * The stock CAF device tree ships qg-batterydata-alium-3600mah.dtsi
 * which is a QRD (Qualcomm Reference Design) profile for a 3600mAh
 * test battery. The commercial Redmi Note 12 4G ships a 5000mAh BN5M
 * cell. This file provides the corrected battery data.
 *
 * What changes vs the 3600mAh profile:
 *   - qcom,design-capacity-mah = 5000 (was 3600 in QRD, 3000 in tapas DTS)
 *   - qcom,fastchg-current-ma = 5400 (UNCHANGED — 5.4A is the cell-side
 *     max current, set by the SMB5 charger IC hardware limit)
 *   - qcom,max-voltage-uv = 4350000 (UNCHANGED — 4.35V is the cell's
 *     max voltage, a physical property of the BN5M cell)
 *
 * What does NOT change:
 *   - NTC thermistor values (battery-beta, battery-therm-kohm) — these
 *     are physical properties of the thermistor, not the cell capacity
 *   - Battery ID resistor (batt-id-kohm) — hardware, same for BN5M
 *   - JEITA temperature ranges — safety thresholds, cell-chemistry-based
 *   - Step charging voltage thresholds — voltage-based, not capacity-based
 *   - FCC stepping parameters — current-based, hardware-limited
 *
 * Power explanation:
 *   33W is the USB input power (9V/3A via HVDCP3 or 11V/3A via PD).
 *   The cell never sees 33W directly. At 5.4A × 4.35V = 23.5W cell power.
 *   The difference is conversion efficiency and overhead in the SMB5 IC.
 *   The 33W spec refers to the charger's input power rating, not the
 *   cell's charging power.
 *
 * Source: GSMArena (5000mAh, 33W), mi.com official specs (5000mAh, 33W),
 *         power_profile.xml in device tree (battery.capacity = 5000).
 */

&pm7250b_qg {
	qcom,battery-data = <&bn5m_batterydata>;
};

&pm7250b_charger {
	qcom,battery-data = <&bn5m_batterydata>;
};

bn5m_batterydata: qcom,battery-data {
	compatible = "qcom,battery-data";
	qcom,battery-id = <0>;
	#address-cells = <1>;
	#size-cells = <1>;

	/* BN5M 5000mAh Li-Po cell — Redmi Note 12 4G */
	qcom,batt-id-kohm = <107>;
	qcom,battery-beta = <4250>;
	qcom,battery-therm-kohm = <100>;

	/* Design capacity — corrected from 3600mAh (QRD) to 5000mAh (commercial) */
	qcom,design-capacity-mah = <5000>;

	/* Max cell voltage — 4.35V (physical limit of BN5M cell) */
	qcom,max-voltage-uv = <4350000>;
	qcom,fg-cc-cv-threshold-uv = <4340000>;

	/* Fast charge current — 5.4A (SMB5 hardware limit, NOT 33W) */
	qcom,fastchg-current-ma = <5400>;

	/* JEITA FCC (Fast Charge Current) ranges — temperature-based safety */
	qcom,jeita-fcc-ranges = <
		0    50   2500000   /* 0-5°C:   2.5A (cold, reduced) */
		51   400  5400000   /* 6-40°C:  5.4A (normal, full speed) */
		401  450  2500000   /* 41-45°C: 2.5A (warm, reduced) */
	>;

	/* JEITA FV (Float Voltage) ranges — temperature-based safety */
	qcom,jeita-fv-ranges = <
		0    50   4250000   /* 0-5°C:   4.25V (cold, reduced) */
		51   400  4350000   /* 6-40°C:  4.35V (normal, full voltage) */
		401  450  4250000   /* 41-45°C: 4.25V (warm, reduced) */
	>;

	/* Step charging — voltage-based CC-CV transition */
	qcom,step-charging-ranges = <
		3600000     3800000  5400000  /* 3.6V-3.8V: 5.4A CC */
		3800001     4300000  3600000  /* 3.8V-4.3V: 3.6A CC */
		4300001     4350000  2500000  /* 4.3V-4.35V: 2.5A CV */
	>;

	/* JEITA soft thresholds (°C) — reduce FCC before hard limit */
	qcom,jeita-soft-thresholds = <
		5    /* COOL: below 5°C, reduce FCC */
		40   /* WARM: above 40°C, reduce FCC */
	>;

	/* JEITA hard thresholds (°C) — stop charging */
	qcom,jeita-hard-thresholds = <
		0    /* COLD: below 0°C, stop charging */
		45   /* HOT: above 45°C, stop charging */
	>;
};
