## patches/apex-new/apex-charge/src/Kconfig
```kconfig
# Fragment appended to drivers/apex/Kconfig by apply.sh (idempotent)
config APEX_CHARGE
	tristate "APEX charge limiting"
	depends on APEX_SYSFS && POWER_SUPPLY
	default m
	help
	  APEX charge limiting module. Stops charging at a user-set
	  battery percentage by braking the main charger's charge
	  current through the power_supply framework, re-asserting
	  periodically against the ROM's charger daemons, with 3%
	  hysteresis.

	  Exposes /sys/class/apex/charge/:
	    charge_limit_percent  - rw (0=disabled, 80-100)
	    status                - r  (JSON: limit, state, capacity,
	                                  temperature, voltage, current)

	  If unsure, say M.
```

## patches/apex-new/apex-root/src/kernelsu/Kconfig
```kconfig
menu "KernelSU"

config KSU
	tristate "KernelSU function support"
	depends on KPROBES && EXT4_FS
	default y
	help
	  Enable kernel-level root privileges on Android System.
	  Requires CONFIG_KPROBES for kernel hooking support.
	  Requires CONFIG_EXT4_FS for `ext4_unregister_sysfs`.
	  To compile as a module, choose M here: the
	  module will be called kernelsu.

config KSU_DEBUG
	bool "KernelSU debug mode"
	depends on KSU
	default n
	help
	  Enable KernelSU debug mode.

config KSU_DISABLE_MANAGER
	bool "Disable KernelSU manager integration"
	depends on KSU
	default n
	help
	  Disable manager APK detection and manager-specific handling.
	  Root will be used in place of manager-only functionality.

config KSU_DISABLE_POLICY
	bool "Disable KernelSU policy profiles"
	depends on KSU
	default n
	help
	  Disable per-app root/non-root profile customization.
	  Escalation will always use the default full root profile, and
	  non-root handling will follow the global umount policy only.

config KSU_X86_PATCH_SYSCALL_DISPATCHER
	bool "Dynamically patch x64's hardened syscall dispatcher to support syscall hooks"
	depends on KSU && X86_64
	default n
	help
	  Dynamically patch x64's hardened syscall dispatcher to support syscall hooks. This is a
	  replacement for a kernel source code patch, and is useful for x86_64 LKM mode.

endmenu

menu "KernelSU - SUSFS"

config KSU_SUSFS
	bool "KernelSU addon - SUSFS"
	depends on KSU
	default y
	help
	  Patch and enable SUSFS (root hiding) with KernelSU.

config KSU_SUSFS_SUS_PATH
	bool "Hide suspicious paths"
	depends on KSU_SUSFS
	default y

config KSU_SUSFS_SUS_MOUNT
	bool "Hide suspicious mounts"
	depends on KSU_SUSFS
	default y

config KSU_SUSFS_SUS_MOUNT_MNT_ID_REORDER
	bool "Reorder mount ids in mountinfo (experimental)"
	depends on KSU_SUSFS_SUS_MOUNT
	default n

config KSU_SUSFS_SUS_KSTAT
	bool "Spoof suspicious kstat"
	depends on KSU_SUSFS
	default y

config KSU_SUSFS_SUS_MAPS
	bool "Spoof suspicious maps"
	depends on KSU_SUSFS
	default y

config KSU_SUSFS_SUS_PROC_FD_LINK
	bool "Spoof suspicious fd links (experimental)"
	depends on KSU_SUSFS
	default n

config KSU_SUSFS_SUS_MEMFD
	bool "Hide/spoof suspicious memfd (experimental)"
	depends on KSU_SUSFS
	default n

config KSU_SUSFS_TRY_UMOUNT
	bool "Use KSU try_umount for user-defined mounts"
	depends on KSU_SUSFS
	default y

config KSU_SUSFS_SPOOF_UNAME
	bool "Spoof uname"
	depends on KSU_SUSFS
	default y

config KSU_SUSFS_ENABLE_LOG
	bool "Log SUSFS to kernel log"
	depends on KSU_SUSFS
	default y

endmenu
```

## patches/apex-new/apex-sysfs/src/Kconfig
```kconfig
config APEX_SYSFS
	tristate "APEX sysfs control plane"
	default y
	help
	  This enables the /sys/class/apex/ sysfs class which provides
	  a top-level interface for APEX kernel features. All APEX
	  feature modules register themselves under this class.

	  If unsure, say Y.
```

## patches/apex-state/Kconfig.append
```kconfig
config APEX
	bool "apex control plane"
	help
	  In-kernel apex state machine: /proc/apex/* status surface,
	  16-row decision table over (screen, charging, audio, fg-uid),
	  RTC wakealarm mirror, 5-minute health tick, panic incident ring.
	  Built-in (not a module): the surface must exist before userspace.
```

## patches/quarantine/apex-governor/Kconfig.append
```kconfig
# Choice option (must be inside the choice block, before endchoice)
config CPU_FREQ_DEFAULT_GOV_APEX
	bool "apex"
	depends on CPU_FREQ
	select CPU_FREQ_GOV_APEX
	help
	  Use the 'apex' governor as the default.

# Governor definition (goes after endchoice, alongside other governors)
config CPU_FREQ_GOV_APEX
	tristate "'apex' cpufreq policy governor"
	depends on CPU_FREQ
	select CPU_FREQ_GOV_COMMON
	help
	  'apex' - per-cluster governor for the A73/A53 clusters with:
	  - non-linear power-curve load mapping (quadratic default, tunable)
	  - screen-off ceiling (screen_off_pct) and burst passthrough
	  - iowait boost for UFS app-launch latency
	  - hysteresis to prevent frequency oscillation
	  - fast_switch support for EPSS sub-microsecond transitions
	  - per-cluster auto-tuning (aggressive on A73, conservative on A53)
	  - gaming mode override (always max within thermal limits)
	  EAS-aware: honors policy->max caps.

	  To compile this driver as a module, choose M here: the
	  module will be called cpufreq_apex.
```

## patches/quarantine/apex-watchdog/Kconfig.append
```kconfig
config APEX_WATCHDOG
	bool "apex self-healing watchdog"
	depends on APEX
	help
	  In-kernel watchdog that checks CPU, GPU, thermal, ZRAM, and battery
	  subsystems every 5 minutes. Attempts recovery on anomaly; panics
	  after 3 consecutive failures. Exposes /proc/apex/watchdog.
	  Built-in: must run before userspace.
```
